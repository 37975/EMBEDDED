#include <WiFi.h>
#include <esp_now.h>
#include <esp_wifi.h>
#include <Firebase_ESP_Client.h>
#include "addons/TokenHelper.h"
#include "addons/RTDBHelper.h"
#include <time.h>
#include "driver/uart.h"
#include "esp_sleep.h"
#include "driver/gpio.h"
#include <SPI.h>
#include <Wire.h>
#include <Adafruit_GFX.h>
#include <Adafruit_SH110X.h>
#include <freertos/FreeRTOS.h>
#include <freertos/task.h>
#include <freertos/semphr.h>

#define WIFI_SSID       "Realme_12"
#define WIFI_PASSWORD   "123456789012"
#define FIREBASE_HOST   "embedded-cc90e-default-rtdb.asia-southeast1.firebasedatabase.app"
#define FIREBASE_SECRET "wBhPfRAptoio9WFNrICysJCq4b99L96pOekdvWV3"
#define NODE_ID         "indoor"
#define PATH_LATEST     "/sensors/" NODE_ID "/latest"
#define PATH_HISTORY    "/sensors/" NODE_ID "/history"
#define BTN_SLEEP 26
#define BTN_MODE  33
#define POT_PIN   32
#define LED_R    14
#define LED_G    13
#define LED_B    12
#define LED_OFF  LOW
#define LED_ON   HIGH
#define UART_PORT UART_NUM_2
#define RX_PIN    16
#define TX_PIN    17
#define i2c_Address 0x3c
#define SCREEN_WIDTH 128
#define SCREEN_HEIGHT 64
#define OLED_RESET -1

uint8_t receiverAddress[] = {0xCC, 0x7B, 0x5C, 0x28, 0x43, 0x58};

typedef struct __attribute__((packed)) {
  uint8_t type;
  char cmd[10];
  int  pm25;
  int  fanSpeed;
} Message;

// --- FreeRTOS Variables ---
TaskHandle_t CommsTaskHandle;
SemaphoreHandle_t dataMutex;

volatile bool pauseComms = false;
volatile bool commsIsPaused = false;

// --- Shared Variables ---
Message data;
int    mode           = 1;
int    prevMode       = -1;
int    lastPM25       = 0;
int    lastPM10       = 0;
int    lastPotFanSpeed = 0;
int    modeChangeSendCount = 0;

FirebaseData   fbdo;
FirebaseAuth   auth;
FirebaseConfig config;

volatile bool          sleepRequested = false;
volatile unsigned long lastSleepPress = 0;
bool                   lastBtnMode    = HIGH;
unsigned long lastSend    = 0;
unsigned long lastHistory = 0;

Adafruit_SH1106G display = Adafruit_SH1106G(SCREEN_WIDTH, SCREEN_HEIGHT, &Wire, OLED_RESET);

// --- OLED BITMAPS ---
const uint8_t ManualDisplay[] PROGMEM = {
  0x00, 0x00, 0x00, 0x00, 0x00, 0x00, 0x00, 0x00, 0x00, 0x00, 0x00, 0x00, 0x00, 0x00, 0x00, 0x00, 
  0x00, 0x00, 0x00, 0x00, 0x00, 0x00, 0x00, 0x00, 0x00, 0x00, 0x00, 0x00, 0x00, 0x00, 0x00, 0x00, 
  0x00, 0x00, 0x00, 0x20, 0x8e, 0x3c, 0x7c, 0x10, 0x4f, 0x20, 0xa1, 0x3c, 0x80, 0x00, 0x00, 0x00, 
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  0x00, 0x00, 0x00, 0x00, 0x00, 0x00, 0x00, 0x00, 0x80, 0x00, 0x00, 0x00, 0x00, 0x00, 0x00, 0x00
};
const uint8_t AutoDisplay[] PROGMEM = {
  0x00, 0x00, 0x00, 0x00, 0x00, 0x00, 0x00, 0x00, 0x00, 0x00, 0x00, 0x00, 0x00, 0x00, 0x00, 0x00, 
  0x00, 0x00, 0x00, 0x00, 0x00, 0x00, 0x00, 0x00, 0x00, 0x00, 0x00, 0x00, 0x00, 0x00, 0x00, 0x00, 
  0x00, 0x00, 0x00, 0x00, 0x41, 0x1c, 0x78, 0xf8, 0x1e, 0x42, 0xfe, 0x38, 0x00, 0x00, 0x00, 0x00, 
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  0x00, 0x00, 0x00, 0x00, 0x00, 0x00, 0x00, 0x00, 0x80, 0x00, 0x00, 0x00, 0x00, 0x00, 0x00, 0x00
};

// ═══════════════════════════════════════════════════════════
// Core 1 (UI & Hardware Updates)
// ═══════════════════════════════════════════════════════════
void updateOLED() {
  display.clearDisplay();

  int currentModeCopy = 1;
  int fanSpeedCopy = 0;
  int pm25Copy = 0;

  // 🟢 จุดแก้ไขสำคัญ: ป้องกันการไปเผลอตั้งค่ากลับเป็นเริ่มต้น
  if (xSemaphoreTake(dataMutex, portMAX_DELAY)) {
    currentModeCopy = mode;
    fanSpeedCopy = data.fanSpeed;
    pm25Copy = data.pm25;
    xSemaphoreGive(dataMutex);
  }

  int fanPercent = 0;
  if (currentModeCopy == 1) { 
      // โหมด Auto: จำลองการคำนวณ PWM จาก PM2.5 ด้วยสมการเดียวกับ Receiver
      float t = constrain(pm25Copy, 0, 150) / 150.0f;
      float curve = t * t;
      int autoPWM = constrain((int)(100 + curve * (255 - 100)), 100, 255);
      fanPercent = map(autoPWM, 100, 255, 1, 100);
  } else {
      // โหมด Manual: ใช้ค่าจากการบิด Potentiometer
      fanPercent = map(fanSpeedCopy, 100, 255, 1, 100);
  }
  
  fanPercent = constrain(fanPercent, 1, 100);

  if (currentModeCopy == 1) {
    display.drawBitmap(0, 0, AutoDisplay, 128, 64, SH110X_WHITE);
    display.setTextSize(1);
    display.setTextColor(SH110X_WHITE);
    //display PM 2.5
    display.setTextSize(2);
    display.setCursor(60, 20);
    display.print(pm25Copy);
    //display
    display.setTextSize(1);
    display.setCursor(5, 45);
    display.print("Speed");
    display.setCursor(35, 50);
    display.printf("%d%%", fanPercent);
    display.setCursor(5, 45);
  } else {
    display.drawBitmap(0, 0, ManualDisplay, 128, 64, SH110X_WHITE);
    display.setTextSize(2);
    display.setTextColor(SH110X_WHITE);
    display.setCursor(70, 20);
    display.printf("%d%%", fanPercent);
    display.setTextSize(1);
    display.setCursor(4, 44);
    display.print("PM2.5");
    display.setCursor(7, 53);
    display.print(lastPM25+String("ug/m^3"));
  }
  display.setTextSize(1);
  display.setCursor(74, 45);
  display.print(WiFi.status() == WL_CONNECTED ? "W -> C" : "W -> X");
  display.setCursor(74, 55);
  display.print(Firebase.ready() ? "FB-> C" : "FB -> X");

  display.display();
}

void IRAM_ATTR onSleepBtn() {
  unsigned long now = millis();
  if (now > 2000 && now - lastSleepPress > 600) {
    sleepRequested = true;
    lastSleepPress = now;
  }
}

void setupRGB() {
  pinMode(LED_R, OUTPUT); digitalWrite(LED_R, LED_OFF);
  pinMode(LED_G, OUTPUT); digitalWrite(LED_G, LED_OFF);
  pinMode(LED_B, OUTPUT); digitalWrite(LED_B, LED_OFF);
}

void setRGB(bool r, bool g, bool b) {
  digitalWrite(LED_R, r ? LED_ON : LED_OFF);
  digitalWrite(LED_G, g ? LED_ON : LED_OFF);
  digitalWrite(LED_B, b ? LED_ON : LED_OFF);
}

void updateLED(int pm25, int m) {
  if      (m == 0)   setRGB(0, 0, 0);
  else if (pm25 < 12)  setRGB(0, 1, 0);
  else if (pm25 < 35)  setRGB(1, 1, 0);
  else if (pm25 < 75)  setRGB(1, 1, 0);
  else if (pm25 < 150) setRGB(1, 0, 0);
  else               setRGB(1, 0, 1);
}

int readPot() {
  return analogRead(POT_PIN);
}

void setupUART() {
  uart_config_t cfg = {
    .baud_rate  = 9600,
    .data_bits  = UART_DATA_8_BITS,
    .parity     = UART_PARITY_DISABLE,
    .stop_bits  = UART_STOP_BITS_1,
    .flow_ctrl  = UART_HW_FLOWCTRL_DISABLE
  };
  uart_param_config(UART_PORT, &cfg);
  uart_set_pin(UART_PORT, TX_PIN, RX_PIN, UART_PIN_NO_CHANGE, UART_PIN_NO_CHANGE);
  uart_driver_install(UART_PORT, 1024, 0, 0, NULL, 0);
}

int readPM() {
  uint8_t buffer[32];
  int len = uart_read_bytes(UART_PORT, buffer, 32, 20 / portTICK_PERIOD_MS);
  
  // 🟢 จุดแก้ไขสำคัญ: ป้องกันค่าขยะ ถ้าอ่านมาได้ไม่ครบ 32 ไบต์ให้เคลียร์ทิ้ง
  if (len == 32 && buffer[0] == 0x42 && buffer[1] == 0x4D) {
    lastPM10 = buffer[10] * 256 + buffer[11];
    return buffer[12] * 256 + buffer[13];
  } else if (len > 0) {
    uart_flush_input(UART_PORT); // ล้างข้อมูลตกค้างเพื่อเริ่มรับรอบใหม่
  }
  return -1;
}

// ═══════════════════════════════════════════════════════════
// Core 0 (Communications & Background Tasks)
// ═══════════════════════════════════════════════════════════
void initESPNow() {
  esp_now_deinit();
  delay(20);
  if (esp_now_init() != ESP_OK) {
    Serial.println("[ESP-NOW] init failed"); return;
  }
  if (!esp_now_is_peer_exist(receiverAddress)) {
    esp_now_peer_info_t peer = {};
    memcpy(peer.peer_addr, receiverAddress, 6);
    peer.channel = 0;
    peer.encrypt = false;
    esp_now_add_peer(&peer);
  }
  Serial.println("[ESP-NOW] ✓ ready");
}

void resyncWiFiChannel() {
  Serial.print("[WAKE] Resyncing WiFi channel");
  WiFi.disconnect();
  delay(100);
  WiFi.begin(WIFI_SSID, WIFI_PASSWORD);
  unsigned long t0 = millis();
  while (WiFi.status() != WL_CONNECTED && millis() - t0 < 8000) {
    Serial.print(".");
    delay(300);
  }
  if (WiFi.status() == WL_CONNECTED) {
    uint8_t ch; wifi_second_chan_t second;
    esp_wifi_get_channel(&ch, &second);
    Serial.printf("\n[WAKE] ✓ WiFi OK — channel: %d\n", ch);
  } else {
    Serial.println("\n[WAKE] ✗ WiFi reconnect failed");
  }
  initESPNow();
}

long long getTimestampMs() {
  struct tm t;
  if (!getLocalTime(&t)) return (long long)millis();
  return (long long)mktime(&t) * 1000LL;
}

void sendSensorData(int pm25_val, int pm10_val, String mode_val) {
  if (!Firebase.ready()) return;
  
  FirebaseJson json;
  json.set("pm25",      pm25_val);
  json.set("pm10",      pm10_val);
  json.set("mode",      mode_val);
  json.set("node_id",   NODE_ID);
  json.set("timestamp", getTimestampMs());
  if (Firebase.RTDB.setJSON(&fbdo, PATH_LATEST, &json)) {
    Serial.printf("[Firebase] ✓ pm25=%d mode=%s\n", pm25_val, mode_val.c_str());
  }
  
  if (millis() - lastHistory >= 30000) {
    lastHistory = millis();
    Firebase.RTDB.pushJSON(&fbdo, PATH_HISTORY, &json);
  }
}

void commsTask(void *pvParameters) {
  for (;;) {
    if (pauseComms) {
      commsIsPaused = true;
      vTaskDelay(50 / portTICK_PERIOD_MS);
      continue; 
    }
    commsIsPaused = false;

    Message localData;
    int localPM25, localPM10;
    int localMode;
    if (xSemaphoreTake(dataMutex, portMAX_DELAY)) {
      localData = data;
      localPM25 = lastPM25;
      localPM10 = lastPM10;
      localMode = mode;
      xSemaphoreGive(dataMutex);
    }

    esp_now_send(receiverAddress, (uint8_t*)&localData, sizeof(localData));

    unsigned long now = millis();
    if (now - lastSend >= 5000) {
      lastSend = now;
      String modeStr = (localMode == 1) ? "auto" : "manual";
      sendSensorData(localPM25, localPM10, modeStr);
      
      Serial.println("─────────────────────────────");
      Serial.printf("  MODE  : %s\n",       modeStr.c_str());
      Serial.printf("  PM2.5 : %d µg/m³\n", localPM25);
      Serial.printf("  PM10  : %d µg/m³\n", localPM10);
      Serial.println("─────────────────────────────");
    }

    vTaskDelay(200 / portTICK_PERIOD_MS);
  }
}

void OLEDSleep(){
    display.clearDisplay();
    display.setTextSize(1);
    display.setTextColor(SH110X_WHITE);
    display.setCursor(4, 28); 
    display.print("Prepare to sleep ...");
    display.display();
    delay(1500);
    display.clearDisplay();
    display.display();
}
void OLEDWeakUp(){
    display.clearDisplay();
    display.setTextSize(1);
    display.setTextColor(SH110X_WHITE);
    display.setCursor(4, 28); 
    display.print("Waking up....");
    display.display();
    delay(500);
    display.clearDisplay();
    display.setCursor(4, 28); 
    display.print("Resync Wifi connect....");
    display.display();
}
// ═══════════════════════════════════════════════════════════
// SLEEP / WAKE Logic (Core 1)
// ═══════════════════════════════════════════════════════════
void enterSleep() {
  Serial.println("[SLEEP] Preparing...");
  OLEDSleep();
  if (xSemaphoreTake(dataMutex, portMAX_DELAY)) {
    data.type = 1;
    strcpy(data.cmd, "sleep");
    Serial.print("++++++++++Sending Sleep Cmd++++++++++");
    data.fanSpeed = 100;
    xSemaphoreGive(dataMutex);
  }

  for (int i = 0; i < 3; i++) {
    esp_now_send(receiverAddress, (uint8_t*)&data, sizeof(data));
    delay(50);
  }

  detachInterrupt(digitalPinToInterrupt(BTN_SLEEP));
  detachInterrupt(digitalPinToInterrupt(BTN_MODE));
  setRGB(0,0,0);

  pauseComms = true;
  unsigned long waitStart = millis();
  while (!commsIsPaused && (millis() - waitStart < 1000)) { 
    delay(10); 
  }
  Serial.println("[SLEEP] CommsTask Parked Safely");
  esp_now_deinit();
  WiFi.disconnect(true);
  WiFi.mode(WIFI_OFF);
  Serial.println("[SLEEP Wifi Off] Zzz...");
  delay(200);

  while (digitalRead(BTN_SLEEP) == LOW) { delay(10); }
  delay(200);

  esp_sleep_enable_ext0_wakeup((gpio_num_t)BTN_SLEEP, 0);
  Serial.flush();
  esp_light_sleep_start();

  // --- WAKE ---
  Serial.println("[WAKE] Good morning!");
  setupRGB();
  OLEDWeakUp();
  delay(300);

  sleepRequested = false;
  
  if (xSemaphoreTake(dataMutex, portMAX_DELAY)) {
    mode           = 1;
    prevMode       = -1;
    xSemaphoreGive(dataMutex);
  }

  WiFi.mode(WIFI_STA);
  resyncWiFiChannel(); 
  delay(100);

  pauseComms = false;
  Serial.println("[WAKE] CommsTask Resumed");
  
  Message wakeCmd;
  wakeCmd.type = 1;
  strcpy(wakeCmd.cmd, "auto");
  wakeCmd.fanSpeed = 0;
  for (int i = 0; i < 5; i++) {
    esp_now_send(receiverAddress, (uint8_t*)&wakeCmd, sizeof(wakeCmd));
    delay(50);
  }
  
  attachInterrupt(digitalPinToInterrupt(BTN_SLEEP), onSleepBtn, FALLING);
}

// ═══════════════════════════════════════════════════════════
// SETUP & LOOP (Core 1)
// ═══════════════════════════════════════════════════════════
void setup() {
  Serial.begin(115200);
  dataMutex = xSemaphoreCreateMutex();

  delay(250);
  display.begin(i2c_Address, true);
  display.clearDisplay();
  display.setRotation(0);
  
  display.setTextSize(1);
  display.setTextColor(SH110X_WHITE);
  display.setCursor(0, 0);
  display.println("System Initializing...");
  display.display();

  Serial.printf("\n=== INDOOR [%s] ===\n", NODE_ID);

  pinMode(BTN_SLEEP, INPUT_PULLUP);
  pinMode(BTN_MODE,  INPUT_PULLUP);
  attachInterrupt(digitalPinToInterrupt(BTN_SLEEP), onSleepBtn, FALLING);

  setupRGB();
  setRGB(1,0,0); delay(400);
  setRGB(0,1,0); delay(400);
  setRGB(0,0,1); delay(400);
  setRGB(0,0,0);

  // --- 1. เช็คสถานะ WiFi ---
  display.print("WiFi: "); display.display();
  WiFi.mode(WIFI_STA);
  WiFi.begin(WIFI_SSID, WIFI_PASSWORD);
  Serial.print("WiFi");
  unsigned long t0 = millis();
  while (WiFi.status() != WL_CONNECTED) {
    Serial.print("."); delay(300);
    if (millis() - t0 > 15000) { 
      Serial.println("\n✗ WiFi FAILED"); 
      break;
    }
  }
  if (WiFi.status() == WL_CONNECTED) {
    uint8_t ch; wifi_second_chan_t second;
    esp_wifi_get_channel(&ch, &second);
    Serial.printf("\n✓ IP: %s | Channel: %d\n", WiFi.localIP().toString().c_str(), ch);
    display.println("OK");
  } else {
    display.println("FAIL");
  }
  display.display();
  
  // --- 2. เช็คสถานะ ESP-NOW ---
  initESPNow();
  display.println("ESP-NOW: Ready"); 
  display.display();

  // --- 3. เช็คสถานะ NTP ---
  display.print("NTP: ");
  display.display();
  configTime(25200, 0, "pool.ntp.org", "time.google.com");
  Serial.print("NTP");
  {
    struct tm t;
    unsigned long t0_ntp = millis();
    while (!getLocalTime(&t) && millis() - t0_ntp < 10000) { Serial.print("."); delay(500); }
    char buf[32] = "timeout";
    if (getLocalTime(&t)) {
        strftime(buf, sizeof(buf), "%Y-%m-%d %H:%M:%S", &t);
        display.println("OK");
    } else {
        display.println("FAIL");
    }
    Serial.printf("\n✓ %s (GMT+7)\n", buf);
  }
  display.display();

  // --- 4. เช็คสถานะ Firebase ---
  display.print("Firebase: "); display.display();
  config.database_url = FIREBASE_HOST;
  config.signer.tokens.legacy_token = FIREBASE_SECRET;
  config.token_status_callback = tokenStatusCallback;
  Firebase.begin(&config, &auth);
  Firebase.reconnectNetwork(true);
  Serial.print("Firebase");
  {
    unsigned long t0_fb = millis();
    while (!Firebase.ready() && millis() - t0_fb < 10000) { Serial.print("."); delay(300); }
  }
  if(Firebase.ready()) {
      display.println("OK");
  } else {
      display.println("FAIL");
  }
  Serial.printf("\n%s\n", Firebase.ready() ? "✓ ready" : "✗ timeout");
  display.display();

  delay(1500); 

  setupUART();
  if (xSemaphoreTake(dataMutex, portMAX_DELAY)) {
    mode = 1;
    prevMode = -1; 
    data.type = 1;
    strcpy(data.cmd, "auto"); 
    data.pm25 = 0;
    data.fanSpeed = 0;
    xSemaphoreGive(dataMutex);
  }
  xTaskCreatePinnedToCore(
    commsTask,       
    "CommsTask",     
    16384,           
    NULL,            
    1,               
    &CommsTaskHandle,
    0              
  );
  Serial.println("=== RUNNING DUAL CORE ===");
}


void loop() {
  if (sleepRequested) {
    if (millis() - lastSleepPress < 1000) {
      enterSleep();
    } else {
      sleepRequested = false;
    }
    return;
  }

  int tempMode = mode;
  int tempFanSpeed = lastPotFanSpeed;
  int tempPM25 = lastPM25;

  // 🟢 จุดแก้ไขสำคัญ: ปรับปรุงการกดปุ่มให้แม่นยำขึ้นแบบไม่ต้องใช้ Delay ขัดจังหวะ
  static unsigned long lastBtnTime = 0;
  bool btnMode = digitalRead(BTN_MODE);
  if (lastBtnMode == HIGH && btnMode == LOW && millis() - lastBtnTime > 250) {
    tempMode = (tempMode == 1) ? 2 : 1;
    lastBtnTime = millis();
    Serial.printf("[BUTTON] Switched Mode to: %d\n", tempMode);
  }
  lastBtnMode = btnMode;

  int pm = readPM();
  if (pm > 0) tempPM25 = pm;
  
  if (tempMode == 2) {
    tempFanSpeed = map(readPot(), 0, 4095, 100, 255);
  }

  if (xSemaphoreTake(dataMutex, portMAX_DELAY)) {
    mode = tempMode;
    lastPM25 = tempPM25;
    lastPotFanSpeed = tempFanSpeed;
    
    if (mode != prevMode) {
      data.type = 1;
      strcpy(data.cmd, mode == 1 ? "auto" : "manual");
      prevMode = mode;
      modeChangeSendCount = 5;
    } else if (modeChangeSendCount > 0) {
      data.type = 1;
      modeChangeSendCount--;
    } else {
      data.type = 0;
      strcpy(data.cmd, "");
    } 
    
    data.pm25 = lastPM25;
    data.fanSpeed = lastPotFanSpeed;
    
    xSemaphoreGive(dataMutex);
  }

  updateLED(tempPM25, tempMode);
  updateOLED();

  delay(50); 
}